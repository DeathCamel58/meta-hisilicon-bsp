## conf/layer.conf
```bitbake
# We have a conf and classes directory, add to BBPATH
BBPATH .= ":${LAYERDIR}"
METAHISILICONBASE := '${@os.path.normpath("${LAYERDIR}/")}'

# We have recipes-* directories, add to BBFILES
BBFILES += "${LAYERDIR}/recipes-*/*/*.bb \
            ${LAYERDIR}/recipes-*/*/*.bbappend"

BBFILE_COLLECTIONS += "meta-hisilicon-bsp"
BBFILE_PATTERN_meta-hisilicon-bsp = "^${LAYERDIR}/"
BBFILE_PRIORITY_meta-hisilicon-bsp = "6"

LAYERDEPENDS_meta-hisilicon-bsp = "core"
LAYERSERIES_COMPAT_meta-hisilicon-bsp = "kirkstone langdale"

# TODO: Add Licenses
# LICENSE_PATH += "${LAYERDIR}/licenses"

LAYERDEPENDS_meta-ti-bsp = " \
    core \
    meta-arm \
"

# SIGGEN_EXCLUDERECIPES_ABISAFE += " \
#     ti-sgx-ddk-km \
#     ti-sgx-ddk-um \
# "

# HOSTTOOLS_NONFATAL += "truncate xxd comm"
```

## conf/machine/include/hi3520dv200.inc
```bitbake
require conf/machine/include/hisilicon-soc.inc
SOC_FAMILY:append = ":hi3520dv200"

# NOTE: `neon` is not supported by this CPU
DEFAULTTUNE ?= "armv7a"
require conf/machine/include/arm/armv7a/tune-cortexa9.inc

# Increase this everytime you change something in the kernel
MACHINE_KERNEL_PR = "r1"

# Set the default Linux version
PREFERRED_PROVIDER_virtual/kernel ?= "linux-yocto"
PREFERRED_VERSION_linux-yocto ?= "3.0.8"

# Set the default U-Boot version
PREFERRED_PROVIDER_virtual/bootloader ?= "u-boot"
PREFERRED_VERSION_u-boot ?= "2010.06"

# Graphics providers and variables
# TODO: Double check these
PREFERRED_PROVIDER_virtual/gpudriver ?= ""
PVR_DISPLAY_CONTROLLER_ALIAS ?= "omapdrm"

# Remove vfat from kernel due to failing kernel build
# Ref: https://github.com/YoeDistro/yoe-distro/issues/572#issuecomment-912097593
KERNEL_FEATURES:remove = "cfg/fs/vfat.scc"

KERNEL_IMAGETYPE = "uImage"

# TODO: Double check these
KERNEL_DEVICETREE = " \
    am437x-gp-evm.dtb \
    ${@oe.utils.conditional('PREFERRED_PROVIDER_virtual/kernel', 'linux-ti-mainline', '', 'am437x-gp-evm-hdmi.dtb', d)} \
    am437x-sk-evm.dtb am437x-idk-evm.dtb \
    am43x-epos-evm.dtb \
    ${@oe.utils.conditional('PREFERRED_PROVIDER_virtual/kernel', 'linux-ti-mainline', '', 'am43x-epos-evm-hdmi.dtb', d)} \
"

# TODO: Double check these
KERNEL_DEVICETREE += "${@oe.utils.conditional('ENABLE_TI_UIO_DEVICES', '1', 'am437x-idk-pru-excl-uio.dtb', '', d)}"

# TODO: Double check these
UBOOT_ARCH = "arm"
UBOOT_MACHINE = "am43xx_evm_config"

# TODO: Double check these
UBOOT_ENTRYPOINT = "0x80008000"
UBOOT_LOADADDRESS = "0x80008000"

# Generate an extlinux.conf file
# TODO: Double check these
UBOOT_EXTLINUX = "1"
UBOOT_EXTLINUX_ROOT = "root=PARTUUID=${uuid}"
UBOOT_EXTLINUX_BOOT_FILES = " \
    extlinux.conf;extlinux/extlinux.conf \
    ${KERNEL_IMAGETYPE} \
    ${KERNEL_DEVICETREE} \
"

# TODO: Double check these
UBOOT_SUFFIX = "img"

# Use the expected value of the ubifs filesystem's volume name in the kernel
# and u-boot.
# TODO: Double check these
UBI_VOLNAME = "rootfs"

# TODO: Double check these
EXTRA_IMAGEDEPENDS += "u-boot"

# List common SoC features
# TODO: Double check these
MACHINE_FEATURES = "kernel26 apm usbgadget usbhost vfat ext2 screen alsa ethernet gpu"

# TODO: Double check these
IMAGE_FSTYPES += "tar.xz wic.xz wic.bmap"
WKS_FILE ?= "sdimage-2part.wks"
IMAGE_BOOT_FILES ?= "u-boot.${UBOOT_SUFFIX} ${UBOOT_EXTLINUX_BOOT_FILES}"
do_image_wic[depends] += "virtual/bootloader:do_deploy"
```

## conf/machine/include/hisilicon-soc.inc
```bitbake
# This is a generic Hisilicon SOC family. It is a superset of all other SOCs
# and platforms defined in meta-hisilicon to allow BSP-level overrides.
SOC_FAMILY = "hisilicon-soc"
KERNEL_DTB_OVERLAY_SUPPORT ?= "1"
require conf/machine/include/soc-family.inc
```

## conf/machine/k9604-w.conf
```bitbake
#@TYPE: Machine
#@NAME: k9604-w
#@DESCRIPTION: This is a DVR/NVR based on the Hisilicon 3520DV200

require conf/machine/include/hi3520dv200.inc


# TODO: Figure out what's necessary for the NVR, and add it here
#MACHINE_FEATURES = ""

# TODO: Check if this is how we set this in Yocto
# The stock firmware used this setting
SERIAL_CONSOLES ?= "ttyAMA0 115200"
SERIAL_CONSOLES_CHECK = "${SERIAL_CONSOLES}"

# TODO: Write a DTB if necessary
#KERNEL_DEVICETREE = " \
#    am57xx-beagle-x15.dtb \
#"

# TODO: Double check these
#PREFERRED_PROVIDER_virtual/xserver ?= "xserver-xorg"
#XSERVER ?= "xserver-xorg \
#           xf86-video-modesetting \
#           "

# TODO: Check if this is necessary.
# The stock `.bin` used these:
#     mem=145M console=ttyAMA0,115200 root=0100 init=/linuxrc mtdparts=hi_sfc:512K(U),256K(E),256K(L),512K(C),2560K(K),12M(R) ramdisk_size=8150
#KERNEL_EXTRA_ARGS += "LOADADDR=${UBOOT_ENTRYPOINT}"

# support runqemu
# TODO: Double check these
EXTRA_IMAGEDEPENDS += "qemu-native qemu-helper-native"
IMAGE_CLASSES += "qemuboot"
QB_DEFAULT_FSTYPE = "wic"
QB_FSINFO = "wic:no-kernel-in-fs"
QB_KERNEL_ROOT = "/dev/vda2"
QB_SYSTEM_NAME = "qemu-system-arm"
QB_MACHINE = "-machine virt"
QB_CPU = "-cpu cortex-a7"
QB_KERNEL_CMDLINE_APPEND = "console=ttyAMA0 systemd.mask=systemd-networkd"
QB_OPT_APPEND = "-device virtio-rng-device"
QB_TAP_OPT = "-netdev tap,id=net0,ifname=@TAP@,script=no,downscript=no"
QB_NETWORK_DEVICE = "-device virtio-net-device,netdev=net0,mac=@MAC@"
QB_ROOTFS_OPT = "-drive id=disk0,file=@ROOTFS@,if=none,format=raw -device virtio-blk-device,drive=disk0"
QB_SERIAL_OPT = ""
QB_TCPSERIAL_OPT = "-device virtio-serial-device -chardev socket,id=virtcon,port=@PORT@,host=127.0.0.1 -device virtconsole,chardev=virtcon"
```
